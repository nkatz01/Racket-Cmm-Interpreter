m = 7
n = 25
a = m > n || n >= 3
b = 0 && 1
c = (m < n) + 1
print a, b, c